## conf/bblayers.conf
```bitbake
# POKY_BBLAYERS_CONF_VERSION is increased each time build/conf/bblayers.conf
# changes incompatibly
POKY_BBLAYERS_CONF_VERSION = "2"

BBPATH = "${TOPDIR}"
BBFILES ?= ""

BBLAYERS ?= " \
  /home/frander06/poky-dunfell/meta \
  /home/frander06/poky-dunfell/meta-poky \
  /home/frander06/poky-dunfell/meta-yocto-bsp \
  /home/frander06/poky-dunfell/meta-openembedded/meta-oe \
  /home/frander06/poky-dunfell/meta-openembedded/meta-python \
  /home/frander06/poky-dunfell/meta-openembedded/meta-multimedia \
  /home/frander06/poky-dunfell/meta-openembedded/meta-filesystems \
  /home/frander06/poky-dunfell/meta-raspberrypi \
  /home/frander06/poky-dunfell/meta-tensorflow-lite \
  /home/frander06/poky-dunfell/build-P2/meta-cine \
  "
```

## meta-cine/conf/layer.conf
```bitbake
# We have a conf and classes directory, add to BBPATH
BBPATH .= ":${LAYERDIR}"

# We have recipes-* directories, add to BBFILES
BBFILES += "${LAYERDIR}/recipes-*/*/*.bb \
            ${LAYERDIR}/recipes-*/*/*.bbappend"

BBFILE_COLLECTIONS += "meta-cine"
BBFILE_PATTERN_meta-cine = "^${LAYERDIR}/"
BBFILE_PRIORITY_meta-cine = "6"

LAYERDEPENDS_meta-cine = "core"
LAYERSERIES_COMPAT_meta-cine = "dunfell"
```
